## main/Kconfig.projbuild
```kconfig
menu "RetroBridge Chile"

    choice RB_BOARD
        prompt "Board profile"
        default RB_BOARD_UNCONFIRMED
        help
            Hardware profile of the ESP32 board (H3-11). The default is the
            unconfirmed profile: the firmware then initialises no microSD bus,
            no board GPIO and no SIO signal. No profile ever configures SIO pins
            (hardware gate H4).

        config RB_BOARD_UNCONFIRMED
            bool "Unconfirmed (hardware not validated: storage and SIO disabled)"

        config RB_BOARD_FUJINET_ATARI_V1X
            bool "FujiNet Atari ESP32, FN32ROV-1.3/1.5 (microSD over SPI only)"
            help
                microSD in SPI mode on GPIO 18 (CLK), 23 (MOSI), 19 (MISO) and
                5 (CS, strapping pin), using SPI3_HOST (VSPI), as drawn in the
                public schematics FN32ROV-1.3-Q24 and FN32ROV-1.5-Q24
                (docs/hardware/fujinet-atari-v1x.md).

                Select it only after reading the board silkscreen and checking
                that the revision and pinout match. Revision 1.6 and later add
                card detect on GPIO15 and are not covered. Flashing requires a
                verified 16 MB backup and explicit authorization
                (docs/hardware/procedimiento-instalacion-recuperacion.md).
    endchoice

    config RB_BENCH_C8
        bool "Bench test C8: DATA IN hand-over on the board alone (Atari disconnected)"
        depends on RB_BOARD_FUJINET_ATARI_V1X
        default n
        help
            Bench build only (H4-C, criterion C8). At boot, drives DATA IN (GPIO21)
            through UART2 and the RMT with a test signal, logs each step and every
            ESP-IDF call, then releases the pin. It does not read MOTOR and never
            gives DATA IN to the cassette. No CI package builds it since 2026-11-25.
            Flash it only with the FujiNet on USB and the SIO cable disconnected from
            the Atari.

    config RB_MENU_SIO
        bool "Test package menu-sio: serve the RetroBridge menu as D1 over the physical SIO"
        depends on RB_BOARD_FUJINET_ATARI_V1X && !RB_BENCH_C8
        default n
        help
            Test package only (menu-sio-fisico). Serves the boot menu as D1 over
            UART2 (DATA IN GPIO21, DATA OUT GPIO33) and COMMAND (GPIO39); reads
            ButtonA (GPIO0) and the SIO +5 V (GPIO35, ADC). The cassette is not
            started. H4 stays unsigned (R2, R7 not accepted; R6 accepted on USB
            power only): connecting it to the 65XE is not authorized. M3a is signed by risk
            acceptance of R1 only: MOTOR (GPIO36) is read as an input.

    config RB_MENU_SIO_TAPE_OUTPUT
        bool "menu-sio: the tape leaves by DATA IN (owner's FN32ROV-1.3-Q24 only, risk acceptance)"
        depends on RB_MENU_SIO
        default n
        help
            T9b (cas-salida-data-in). Only for the owner's FujiNet FN32ROV-1.3-Q24 with the
            owner's 65XE: the owner accepted R2, R6 and R7 for DATA IN without measurement
            (docs/mediciones/aceptacion-data-in-casete-2026-11-26.md). H4 stays unsigned. With
            it, the cassette shares DATA IN (GPIO21) with the disk and the menu may offer a tape.
            Off in every other build. Only the package menu-sio-cinta turns it on, and only that
            package may carry it (tools/ci/firmware_package.py).

    config RB_CAS_ENGINE_FUJINET
        bool "Experimental: play .cas with the owner's FujiNet FSK engine"
        depends on RB_MENU_SIO
        default n
        help
            Experimental variant (cassette-motor-fujinet). The cassette plays with the
            owner's FSK code from the FujiNet beta v1.6.2-atari-fsk-beta.1 (commit
            cf3382f, component rb_fujinet_fsk) and RetroBridge's FujiTapeLoop, instead
            of RetroBridge's CassettePlayer. It changes no gate: it plays only when
            DATA IN is driven exclusively by the cassette, which needs H4 and M3a and
            kTapeOutput (main/menu_sio.cpp), and H4 is not approved. In shared mode
            (UART2 is the disk's) it does not run: RetroBridge's player stays.
            Not for the 65XE: no physical test is authorized.

    config RB_DRIVE_SAVE_STACK
        int "menu-sio: stack of the rb_drive_save task (bytes)"
        depends on RB_MENU_SIO
        range 4096 16384
        default 6144
        help
            The task that writes the remembered drives to the microSD
            (menu-unidades-persistentes). The package checks that save()
            and load(), plus a reserve for stdio and FatFs, fit in it.

endmenu
```
